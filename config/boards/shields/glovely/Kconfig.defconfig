## config/boards/shields/glovely/Kconfig.defconfig
```kconfig
if SHIELD_GLOVELY_CENTRAL

# Max 16 characters in keyboard name
config ZMK_KEYBOARD_NAME
    default "Glovely"

config ZMK_SPLIT_ROLE_CENTRAL
    default y

config ZMK_SPLIT
    default y

config ZMK_SPLIT_BLE_CENTRAL_PERIPHERALS
    default 2

# Set this to ZMK_SPLIT_BLE_CENTRAL_PERIPHERALS + your desired number of BT profiles (default is 5)
config BT_MAX_CONN
    default 6

# Set this to the same number as BT_MAX_CONN
config BT_MAX_PAIRED
    default 6

config USB_DEVICE_STACK
    default y

endif

if SHIELD_GLOVELY_LEFT

# Max 16 characters in keyboard name
config ZMK_KEYBOARD_NAME
    default "Glovely left"

endif

if SHIELD_GLOVELY_RIGHT

# Max 16 characters in keyboard name
config ZMK_KEYBOARD_NAME
    default "Glovely right"

endif

if SHIELD_GLOVELY_LEFT || SHIELD_GLOVELY_RIGHT

config ZMK_SPLIT_ROLE_CENTRAL
    default n

config ZMK_SPLIT
    default y

endif
```

## config/boards/shields/glovely/Kconfig.shield
```kconfig
config SHIELD_GLOVELY_CENTRAL
    def_bool $(shields_list_contains,glovely_central)

config SHIELD_GLOVELY_LEFT
    def_bool $(shields_list_contains,glovely_left)

config SHIELD_GLOVELY_RIGHT
    def_bool $(shields_list_contains,glovely_right)
```

## config/west.yml
```yaml
# This file specifies the build dependencies for Github Action workflows and
# for local build environments. The workspace has four toplevel directories
# containing the user config, modules, zephy and ZMK.
#
# ZMK-Workspace
# ├── config
# ├── modules
# ├── zephyr
# └── zmk
#
# To create a local build environment, clone this repository and then run the
# following commands from its toplevel directory:
#
# $ west init -l config
# $ west update
# $ west zephyr-export
#
---
manifest:
  remotes:
    - name: zmkfirmware
      url-base: https://github.com/zmkfirmware

  projects:
    - name: zmk
      remote: zmkfirmware
      revision: main
      import: app/west.yml

  self:
    path: config
```
