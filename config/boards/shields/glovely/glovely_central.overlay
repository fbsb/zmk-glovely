#include <dt-bindings/zmk/matrix_transform.h>
#include "glovely_matrix.dtsi"

/ {
    chosen {
        zmk,kscan = &mock_kscan;
        // zmk,studio-rpc-uart = &zmk_studio_rpc_usb_uart;
    };

    mock_kscan: mock_kscan_0 {
        compatible = "zmk,kscan-mock";
        columns = <0>;
        rows = <0>;
        events = <0>;
    };
};

// &zephyr_udc0 {
    //     zmk_studio_rpc_usb_uart: zmk_studio_rpc_usb_uart {
        //         compatible = "zephyr,cdc-acm-uart";
    //     };
// };
